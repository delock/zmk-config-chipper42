## config/boards/shields/chipper42/Kconfig.shield
```kconfig
config SHIELD_CHIPPER42_LEFT
	def_bool $(shields_list_contains,chipper42_left)

config SHIELD_CHIPPER42_RIGHT
	def_bool $(shields_list_contains,chipper42_right) 

config CONFIG_ZMK_COMBO_MAX_COMBOS_PER_KEY
	int 8
```

## config/west.yml
```yaml
manifest:
  remotes:
    - name: zmkfirmware
      url-base: https://github.com/zmkfirmware
    - name: delock
      url-base: https://github.com/delock
  projects:
    - name: zmk
      remote: delock
      revision: main-3.2
      import: app/west.yml
  self:
    path: config
```
